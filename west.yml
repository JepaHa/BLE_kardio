## west.yml
```yaml
manifest:
  remotes:
  - name: zephyr
    url-base: https://github.com/zephyrproject-rtos
  projects:
  - name: zephyr
    remote: zephyr
    revision: v4.2.0
    west-commands: scripts/west-commands.yml
    import:
      path-prefix: deps/zephyr
      name-allowlist:
        - cmsis_6
        - hal_stm32
```
