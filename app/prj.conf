## CMakeLists.txt
```
cmake_minimum_required(VERSION 3.27)

# Helper function to find Zephyr base from west top directory
function(zephyr_base_from_west_topdir)
  execute_process(COMMAND west topdir OUTPUT_VARIABLE TOPDIR)
  string(STRIP ${TOPDIR} TOPDIR)
  execute_process(COMMAND west config zephyr.base OUTPUT_VARIABLE BASE)
  string(STRIP ${BASE} BASE)
  set(ENV{ZEPHYR_BASE} ${TOPDIR}/${BASE})
endfunction()

if(NOT DEFINED ENV{ZEPHYR_BASE})
  zephyr_base_from_west_topdir()
endif()

find_package(Zephyr REQUIRED HINTS $ENV{ZEPHYR_BASE})
project(zephyr-demo)

FILE(GLOB_RECURSE SOURCES src/*.c)
target_include_directories(app PRIVATE include)
target_sources(app PRIVATE ${SOURCES})
```

## prj.conf
```kconfig
CONFIG_GPIO=y
CONFIG_SERIAL=y
CONFIG_UART_CONSOLE=y


# Bluetooth configuration
CONFIG_BT=y
CONFIG_BT_PERIPHERAL=y
CONFIG_BT_DEVICE_NAME="BLE_Kardio"
CONFIG_BT_HOST_CRYPTO=n
CONFIG_BT_GATT_DYNAMIC_DB=y



# Entropy/random number generator (required for BLE)
CONFIG_ENTROPY_GENERATOR=y
CONFIG_TEST_RANDOM_GENERATOR=y
CONFIG_ENTROPY_ESP32_RNG=y

# Logging configuration
CONFIG_LOG=y
CONFIG_LOG_MODE_DEFERRED=y
CONFIG_LOG_DEFAULT_LEVEL=3
CONFIG_LOG_BUFFER_SIZE=4096
CONFIG_LOG_PROCESS_THREAD=y
CONFIG_LOG_PROCESS_THREAD_STACK_SIZE=1024
CONFIG_LOG_BACKEND_UART=y
CONFIG_LOG_BACKEND_SHOW_COLOR=n
CONFIG_LOG_BACKEND_FORMAT_TIMESTAMP=y

# Zbus configuration
CONFIG_ZBUS=y
```

## debug.conf
```kconfig
# Optimize for debug
CONFIG_DEBUG_OPTIMIZATIONS=y

CONFIG_ASSERT=y
CONFIG_LOG=y
CONFIG_LOG_MODE_IMMEDIATE=y
CONFIG_LOG_DEFAULT_LEVEL=3

CONFIG_TEST=y
CONFIG_PRINTK=y
```

## boards/native_sim.conf
```kconfig
CONFIG_NATIVE_SIM_SLOWDOWN_TO_REAL_TIME=y
```

## boards/esp32_devkitc.overlay
```dts
/ {
    aliases {
        led0 = &led0;
    };

    leds {
        compatible = "gpio-leds";
        led0: led_0 {
            gpios = <&gpio0 2 GPIO_ACTIVE_HIGH>;
            label = "LED 0";
        };
    };
};
```

## src/main.c
```c
#include <zephyr/kernel.h>
#include <zephyr/logging/log.h>

#include "BLE/ble_init.h"
#include "simulator/spo2_simulator.h"

LOG_MODULE_REGISTER(main, CONFIG_LOG_DEFAULT_LEVEL);

int main(void)
{
    /* Initialize BLE (includes LED initialization) */
    ble_init();

    /* Initialize SpO2 simulator - starts working immediately */
    /* Connection will be established automatically when first data is sent */
    spo2_simulator_init();

    /* Main loop - just sleep, LED is controlled by Bluetooth state */
    while (1) {
        k_msleep(1000);
    }
    return 0;
}
```
